#include <behaviors.dtsi>
#include <dt-bindings/zmk/keys.h>
#include <dt-bindings/zmk/bt.h>
#include <dt-bindings/zmk/outputs.h>

/ {
	keymap {
		compatible = "zmk,keymap";

		default_layer {
			bindings = <
                &kp LEFT_WIN			&kp ESCAPE			&kp BT_CLR
			>;
		};

	};
};

